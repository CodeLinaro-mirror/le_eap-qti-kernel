## defconfig
```kconfig
# Common options
CONFIG_QTI_QRTR=y
CONFIG_QTI_RMNET=y
CONFIG_QTI_QMI_RMNET=y
CONFIG_QTI_QMI_DFC=y
CONFIG_QTI_QMI_POWER_COLLAPSE=y
CONFIG_QTI_USB_BRIDGE=y
CONFIG_QTI_QDSS_BRIDGE=y

# Ethernet option
CONFIG_QTI_QRTR_ETHERNET=y

# PCIe options
CONFIG_QTI_MHI_BUS=y
CONFIG_QTI_MHI_DEBUG=y
CONFIG_QTI_MHI_PCI_GENERIC=y
CONFIG_QTI_MHI_QCOM=y
CONFIG_QTI_MHI_UCI=y
CONFIG_QTI_MHI_NETDEV=y
CONFIG_QTI_QRTR_MHI=y
CONFIG_QTI_RMNET_CTL=y

# USB options
CONFIG_QTI_QRTR_USB=y
CONFIG_QTI_USB_RMNET=y
CONFIG_QTI_USB_KS_BRIDGE=y
CONFIG_QTI_USB_MDM_DATA_BRIDGE=y
CONFIG_USB_USBNET=y
CONFIG_USB_NET_RNDIS_HOST=y

# QMI options
CONFIG_QTI_QMI_HELPERS=y

# Diag options
CONFIG_QTI_DIAG_CHAR=y
CONFIG_QTI_USB_F_DIAG=y
CONFIG_QTI_USB_DIAG_BRIDGE=y

# non-QTI config options
CONFIG_USB_CONFIGFS=y
CONFIG_USB_GADGET=y
CONFIG_IP_ADVANCED_ROUTER=y
CONFIG_NETFILTER=y
CONFIG_NF_CONNTRACK=y
CONFIG_NF_CONNTRACK_IPV4=y
CONFIG_IP_NF_IPTABLES=y
CONFIG_IP_NF_NAT=y
CONFIG_IP_NF_TARGET_MASQUERADE=y
CONFIG_BLK_DEV_NBD=y
CONFIG_VLAN_8021Q=y

# Side Band config options
CONFIG_SDX_EXT_IPC=y
CONFIG_QTI_NOTIFY_SIDEBAND=y

#enable devnmem with restrictions
CONFIG_DEVMEM=y
CONFIG_STRICT_DEVMEM=n
CONFIG_IO_STRICT_DEVMEM=n

#enable GPIO
CONFIG_GPIO_CDEV=y
# CONFIG_GPIO_SYSFS is not set
CONFIG_DEBUG_GPIO=y
CONFIG_GPIO_GENERIC=y
CONFIG_GPIO_MXC=y
```

## drivers-5.x/qti/dfc/Kconfig
```kconfig
#
# RMNET MAP driver
#

menuconfig QTI_QMI_RMNET
	bool "QTI QMI Rmnet Helpers"
	depends on QTI_RMNET
	help
	  Helper for handling interfaces between kernel clients and rmnet
	  driver. It enables the rmnet driver to create/delete DFC/WDA
	  clients and provides the common functionality for data flow control
	  and power save features.


menuconfig QTI_QMI_DFC
	bool "Enable burst mode flow control"
	depends on QTI_QMI_RMNET
	help
	  Say y here to enable support for burst mode data flow control.
	  DFC client provides an interface to the modem dfc service and
	  does burst mode flow control. It enables the flow on receiving flow
	  status indication and disables flows while grant size is reached.
	  If unsure or not use burst mode flow control, say 'N'.

menuconfig QTI_QMI_POWER_COLLAPSE
	bool "Enable power save features"
	depends on QTI_QMI_RMNET
	help
	  Say y here to enable support for power save features.
	  It provides an interface to offload uplink flow control based on
	  detected flow status.
	  If unsure or not use power save feature, say 'N'.
```

## drivers-5.x/qti/qmi/Kconfig
```kconfig
config QTI_QMI_HELPERS
	bool "QTI QMI Helpers"
	depends on QTI_QRTR
	help
          Helper library for handling QMI encoded messages.  QMI encoded
          messages are used in communication between the majority of QRTR
          clients and this helpers provide the common functionality needed for
          doing this from a kernel driver.
```

## drivers-6.18/qti/ipc_logging/Kconfig
```kconfig
config IPC_LOGGING	1
       bool "Debug Logging for IPC Drivers"	
       select GENERIC_TRACER	
       help	
         IPC Logging driver provides a logging option for IPC Drivers.	
         This provides a cyclic buffer based logging support in a driver	
         specific context. This driver also provides a debugfs interface	
         to dump the logs in a live fashion.	

         If in doubt, say no.
```

## drivers-6.18/qti/mhi/Kconfig
```kconfig
# SPDX-License-Identifier: GPL-2.0
#
# MHI bus
#
#Copyright (c) Qualcomm Technologies, Inc. and/or its subsidiaries.
#

source "drivers-6.6/qti/mhi/host/Kconfig"
source "drivers-6.6/qti/mhi/devices/Kconfig"
```

## drivers-6.18/qti/mhi/host/Kconfig
```kconfig
# SPDX-License-Identifier: GPL-2.0-only
#
# MHI bus
#
# Copyright (c) 2018-2020, The Linux Foundation. All rights reserved.
#
# Copyright (c) Qualcomm Technologies, Inc. and/or its subsidiaries.
#

config QTI_MHI_BUS
	tristate "Modem Host Interface (MHI) bus"
	help
	  Bus driver for MHI protocol. Modem Host Interface (MHI) is a
	  communication protocol used by the host processors to control
	  and communicate with modem devices over a high speed peripheral
	  bus or shared memory. Enabling this module will allow host to
	  communicate with external devices that support MHI protocol.

config QTI_MHI_DEBUG
	bool "Debugfs support for the MHI bus"
	depends on QTI_MHI_BUS
	help
	  Enable debugfs support for use with the MHI transport. Allows
	  reading and/or modifying some values within the MHI controller
	  for debug and test purposes.

config QTI_MHI_PCI_GENERIC
	tristate "MHI PCI Generic controller driver"
	depends on QTI_MHI_BUS
	help
	  This driver provides MHI PCI controller driver for devices such as
	  Qualcomm SDX55 based PCIe modems. Say yes here to enable MHI PCIE
	  related function in the MHI transport.
```

## drivers-6.18/qti/pcie_ssr/Kconfig
```kconfig
menu "PCIE_SSR"

config QTI_PCIE_SSR
       tristate "PCIE SSR"
       depends on QTI_MHI_BUS_ARCH
       help
         If you say yes to this option, MHI bus arch support for Qualcomm Technologies, Inc modem chipsets
         will be enabled.

endmenu
```

## drivers-6.18/qti/qdss_bridge/Kconfig
```kconfig
config QTI_QDSS_BRIDGE
        tristate "Configure bridge driver for QTI/Qualcomm Technologies, Inc. MDM"
        depends on QTI_MHI_BUS
        help
          The driver will help route diag traffic from modem side over the QDSS
          sub-system to USB on APSS side. The driver acts as a bridge between the
          MHI and USB interface.
          If unsure, say N.
```

## drivers-6.18/qti/qrtr/Kconfig
```kconfig
# QTI IPC Router configuration
#

config QTI_QRTR
	tristate "QTI IPC Router support"
	help
	  Say Y if you intend to use QTI IPC router protocol.  The
	  protocol is used to communicate with services provided by other
	  hardware blocks in the system.

	  In order to do service lookups, a userspace daemon is required to
	  maintain a service listing.

if QTI_QRTR

config QRTR_WAKEUP_MS
	int "QRTR Wakeup timeout"
	default 0
	help
	  This option is used to configure the wakesource timeout that QRTR
	  should take when a packet is received. The qrtr driver can guarantee
	  that the packet gets queued to the socket but cannot guarantee the
	  client process will get time to run if auto sleep is enabled. This
	  config will help mitigate missed packets on systems where auto sleep
	  is aggressive.

config QTI_QRTR_MHI
	tristate "MHI IPC Router channels"
	depends on QTI_MHI_BUS || (COMPILE_TEST && QTI_MHI_BUS=n)
	help
	  Say Y here to support MHI based ipcrouter channels.  MHI is the
	  transport used for external modem connections for IPC Router.

config QTI_QRTR_USB
	tristate "USB IPC Router channels"
	depends on USB || (COMPILE_TEST && USB=n)
	help
	  Say Y here to support USB based ipcrouter channels.

endif # QRTR_QTI
```

## drivers-6.18/qti/side_band/Kconfig
```kconfig
# SPDX-License-Identifier: GPL-2.0-only

config SDX_EXT_IPC
	tristate "QCOM external ipc driver"
	help
	  This enables the module to help modem communicate with external
	  Application processor connected to Qualcomm Technologies, Inc
	  modem chipset. The modem and APQ can understand each other's
	  state by reading ipc gpios.

	  If unsure, say N.

config QTI_NOTIFY_SIDEBAND
	tristate "QCOM sideband signalling helper"
	help
	  This provides helper APIs and a header file through which
	  transport layer driver can talk to the sideband driver to
	  assert appropriate sideband signal.

	  If unsure, say N.
```

## drivers-6.6/qti/mhi/Kconfig
```kconfig
# SPDX-License-Identifier: GPL-2.0
#
# MHI bus
#
# Copyright (c) 2024 Qualcomm Innovation Center, Inc. All rights reserved.
#

source "drivers-6.6/qti/mhi/host/Kconfig"
source "drivers-6.6/qti/mhi/devices/Kconfig"
```

## drivers-6.6/qti/mhi/devices/Kconfig
```kconfig
# SPDX-License-Identifier: GPL-2.0-only
#
# Copyright (c) 2024 Qualcomm Innovation Center, Inc. All rights reserved.
#

config QTI_MHI_NETDEV
	tristate "MHI Net support for the MHI client"
	depends on QTI_MHI_BUS
	help
	  This is a client for MHI Transport.
	  The MHI-based network device driver facilitates IP traffic transfer
	  between the host and modem. Enabling this driver allows clients
	  to use a standard network interface for data transfer,
	  with over-the-air traffic managed through the MHI netdev interface.

config QTI_MHI_UCI
	tristate "MHI UCI"
	depends on QTI_MHI_BUS
	help
		MHI based uci driver is for transferring data between host and
		modem using standard file operations from user space. Open, read,
		write and close operations are supported by this driver.
```

## drivers/qti/Kconfig
```kconfig
source "drivers/qti/mhi/Kconfig"
source "drivers/qti/qrtr/Kconfig"
source "drivers/qti/rmnet/Kconfig"
source "drivers/qti/rmnet_usb/Kconfig"
source "drivers/qti/usb_bridge/Kconfig"
source "drivers/qti/diag/Kconfig"
source "drivers/qti/usb_diag/Kconfig"
source "drivers/qti/qmi/Kconfig"
source "drivers/qti/ks_bridge/Kconfig"
source "drivers/qti/usb_mdm_data/Kconfig"
```

## drivers/qti/ks_bridge/Kconfig
```kconfig
config QTI_USB_KS_BRIDGE
	tristate "USB QTI kick start bridge driver"
	depends on USB
	help
	  Say Y here if you have a QTI modem device connected via USB that
	  will be bridged in kernel space. This driver works as a bridge to pass
	  boot images, ram-dumps etc.
	  To compile this driver as a module, choose M here: the module will be
	  called ks_bridge. If unsure, choose N.
```

## drivers/qti/mhi/controllers/Kconfig
```kconfig
menu "MHI controllers"

config QTI_MHI_QCOM
       tristate "MHI QCOM"
       depends on QTI_MHI_BUS && PCI
       help
	  If you say yes to this option, MHI bus support for Qualcomm Technologies, Inc modem chipsets
	  will be enabled.

config QTI_MHI_BUS_ARCH
       tristate "MHI BUS ARCH"
       depends on QTI_MHI_BUS && PCI
       help
          If you say yes to this option, MHI bus arch support for Qualcomm Technologies, Inc modem chipsets
          will be enabled.

endmenu
```

## drivers/qti/qrtr/Kconfig
```kconfig
# Qualcomm IPC Router configuration
#

config QTI_QRTR
	tristate "Qualcomm IPC Router support"
	---help---
	  Say Y if you intend to use Qualcomm IPC router protocol.  The
	  protocol is used to communicate with services provided by other
	  hardware blocks in the system.

	  In order to do service lookups, a userspace daemon is required to
	  maintain a service listing.

if QTI_QRTR

config QTI_QRTR_MHI
	tristate "MHI IPC Router channels"
	depends on QTI_MHI_BUS || (COMPILE_TEST && QTI_MHI_BUS=n)
	---help---
	  Say Y here to support MHI based ipcrouter channels.  MHI is the
	  transport used for external modem connections for IPC Router.

config QTI_QRTR_USB
	tristate "USB IPC Router channels"
	depends on USB || (COMPILE_TEST && USB=n)
	---help---
	  Say Y here to support USB based ipcrouter channels.

config QTI_QRTR_ETHERNET
	tristate "Ethernet IPC Router channel"
	help
	  Say Y here to support Ethernet based ipcrouter channels. Ethernet
	  is the transport used for external auto connections for IPC router.
	  This has a dependency on ethernet adaption layer.

endif # QRTR_QTI
```

## drivers/qti/usb_mdm_data/Kconfig
```kconfig
config QTI_USB_F_MDM_DATA
	tristate
	select USB_LIBCOMPOSITE

config QTI_USB_MDM_DATA_BRIDGE
	tristate "USB QTI modem data bridge driver"
	depends on USB
	select QTI_USB_F_MDM_DATA
	help
	  Say Y here if you have a QTI modem device connected via USB that
	  will be bridged in kernel space. This driver works as a bridge to pass
	  data packets between the modem and peripheral usb gadget driver.
	  To compile this driver as a module, choose M here: the module
	  will be called mdm_data_bridge. If unsure, choose N.
```
