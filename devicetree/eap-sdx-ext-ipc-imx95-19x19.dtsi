/*
 * SPDX-License-Identifier: BSD-3-Clause
 * Copyright (c) Qualcomm Technologies, Inc. and/or its subsidiaries.
 */

/ {
        qcom,sdx_ext_ipc {
                compatible = "qcom,sdx-ext-ipc";
                qcom,wakeup-in-gpio = <&i2c5_gpio_expander_21 4 GPIO_ACTIVE_HIGH>;
                qcom,wakeup-out-gpio = <&i2c5_gpio_expander_21 5 GPIO_ACTIVE_LOW>;
                qcom,errfatal-out-gpio = <&i2c5_gpio_expander_21 6 GPIO_ACTIVE_HIGH>;
                qcom,errfatal-in-gpio = <&i2c5_gpio_expander_21 7 GPIO_ACTIVE_HIGH>;
                pinctrl-names = "default";
                qcom,default-policy-nop;
                status = "ok";
        };
};
